## external/Config.in
```kconfig
source "$BR2_EXTERNAL_WFB_PATH/package/rtw88/Config.in"
source "$BR2_EXTERNAL_WFB_PATH/package/wfbya/Config.in"
```

## external/package/rtw88/Config.in
```kconfig
config BR2_PACKAGE_RTW88
        bool "rtw88"
	depends on BR2_LINUX_KERNEL
        help
          Backport of RTW88 drivers for Realtek RTW88 wireless
          controllers.

          https://github.com/lwfinger/rtw88

comment "rtw88 needs a linux kernel to be built"
        depends on !BR2_LINUX_KERNEL
```

## external/package/wfbya/Config.in
```kconfig
config BR2_PACKAGE_WFBYA
        bool "wfbya"
        depends on BR2_LINUX_KERNEL
        help
          A Wi-Fi Broadcaast Client for Multicast.

          https://github.com/hsuenaga/wfb-ya
```
